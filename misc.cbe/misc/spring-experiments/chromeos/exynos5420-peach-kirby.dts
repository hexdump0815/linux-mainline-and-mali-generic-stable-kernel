/*
 * Google Peach Kirby board device tree source
 *
 * Copyright (c) 2013 Google, Inc
 *
 * This program is free software; you can redistribute it and/or modify
 * it under the terms of the GNU General Public License version 2 as
 * published by the Free Software Foundation.
 */

/dts-v1/;
#include "exynos5420.dtsi"
#include "exynos5420-peach-kirby.dtsi"
#include "cros-ec-keyboard.dtsi"

/ {
	model = "Google Peach Kirby";

	compatible = "google,kirby", "google,peach", "samsung,exynos5420";

	/* FIXME: Is this really necessary? */
	display-port-controller {
		samsung,skip-edid-read;
	};
};
